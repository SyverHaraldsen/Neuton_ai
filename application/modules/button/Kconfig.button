## application/modules/button/Kconfig.button
```kconfig
#
# Copyright (c) 2026 Nordic Semiconductor ASA
#
# SPDX-License-Identifier: LicenseRef-Nordic-5-Clause
#

menu "Button Module"

config APP_BUTTON_DEBOUNCE_TIME_MS
	int "Button debounce time in milliseconds"
	default 50
	help
	  The time to debounce the button press.

config APP_BUTTON_DOUBLE_PRESS_TIMEOUT_MS
	int "Button double press timeout in milliseconds"
	default 500
	help
	  The time to wait for a double press.

config APP_BUTTON_LONG_PRESS_TIMEOUT_MS
	int "Button long press timeout in milliseconds"
	default 3000
	help
	  The time required for a long press detection.

module = APP_BUTTON
module-str = Button module
source "subsys/logging/Kconfig.template.log_config"

endmenu
```

## application/modules/detection/Kconfig.detection
```kconfig
#
# Copyright (c) 2026 Nordic Semiconductor ASA
#
# SPDX-License-Identifier: LicenseRef-Nordic-5-Clause
#

menu "Detection Module"

module = APP_DETECTION
module-str = Detection module
source "subsys/logging/Kconfig.template.log_config"

endmenu
```

## application/modules/sampling/Kconfig.sampling
```kconfig
#
# Copyright (c) 2026 Nordic Semiconductor ASA
#
# SPDX-License-Identifier: LicenseRef-Nordic-5-Clause
#

menu "Sampling Module"

config APP_SAMPLING_FREQUENCY_HZ
	int "Sampling frequency in Hz"
	default 100
	help
	  The frequency to sample the IMU at.

module = APP_SAMPLING
module-str = Sampling module
source "subsys/logging/Kconfig.template.log_config"

endmenu
```
